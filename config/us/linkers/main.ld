func_8001D668 = func_8001D640 + 0x28;
func_8001D6F8 = func_8001D640 + 0xB8;
func_8001D000 = func_8001CE40 + 0x1C0;
func_8003D000 = func_8003CDA8 + 0x258;
func_8003C800 = func_8003C4C4 + 0x33C;
func_8003C9D0 = func_8003C4C4 + 0x50C;
func_8003CB14 = func_8003C4C4 + 0x650;
func_8003CC20 = func_8003C4C4 + 0x75C;
func_8003B800 = func_8003B6AC + 0x154;
func_8003C000 = func_8003B6AC + 0x954;
func_80033000 = func_80032F28 + 0xD8;
func_80034800 = func_80034790 + 0x70;
func_80034820 = func_80034790 + 0x90;
func_80034834 = func_80034790 + 0xA4;
func_80032800 = func_800327B0 + 0x50;
func_80036000 = func_80035F94 + 0x6C;
func_80036800 = func_80036738 + 0xC8;
func_8002E800 = func_8002E700 + 0x100;
func_80034E78 = func_80034E5C + 0x1C;
func_8002F000 = func_8002EFDC + 0x24;
func_80031000 = func_80030F84 + 0x7C;
/* Reviewed debug wrapper epilogue follows its source parent. */
func_8002A000 = func_80029FCC + 0x34;

/* Reviewed destructor epilogue follows its emitted source parent. */
func_8002A800 = func_8002A7B8 + 0x48;

/* Reviewed internal continuation: follows its source function when moved. */
func_8002C3B0 = func_8002C39C + 0x14;

SECTIONS
{
    /* Startup initializes gp from this real resident data symbol. */
    _gp = D_80064128;
    HIDDEN(__romPos = 0);
    header_ROM_START = __romPos;
    header_VRAM = ADDR(.header);
    .header : AT(header_ROM_START) SUBALIGN(4)
    {
        FILL(0x00000000);
        header_DATA_START = .;
        build/us/asm/us/main/header.s.o(.data);
        header_DATA_END = .;
        header_DATA_SIZE = ABSOLUTE(header_DATA_END - header_DATA_START);
    }
    __romPos += SIZEOF(.header);
    header_ROM_END = __romPos;
    header_VRAM_END = .;

    main_ROM_START = __romPos;
    main_VRAM = ADDR(.main);
    .main 0x80010000 : AT(main_ROM_START) SUBALIGN(4)
    {
        FILL(0x00000000);
        main_RODATA_START = .;
        build/us/asm/us/main/data/800.rodata.s.o(.rodata);
        jtbl_80010400 = .;
        build/us/src/engine/F800.c.o(.rodata.flags_enable);
        build/us/asm/us/main/data/800.rodata.s.o(.rodata.renderer_gap);
        jtbl_80010418 = .;
        build/us/src/engine/F800.c.o(.rodata.flags_disable);
        build/us/asm/us/main/data/800.rodata.s.o(.rodata.renderer_after);
        build/us/asm/us/main/data/800.rodata.s.o(.rodata.renderer_remainder);
        jtbl_80019A1C = .;
        ASSERT(ABSOLUTE(jtbl_80019A1C) == 0x80019A1C, "inflate table placement");
        build/us/src/engine/2B034.c.o(.rodata);
        ASSERT(ABSOLUTE(.) == 0x80019A54, "inflate table extent");
        build/us/asm/us/main/data/800.rodata.s.o(.rodata.inflate_suffix);
        . = ALIGN(8);
        ASSERT(ABSOLUTE(.) == 0x80019F88, "inflate suffix alignment");
        build/us/asm/us/main/data/800.rodata.s.o(.rodata.inflate_aligned_suffix);
        build/us/src/engine/B618.c.o(.rodata);
        build/us/src/engine/B800.c.o(.rodata);
        build/us/src/engine/C000.c.o(.rodata);
        build/us/src/engine/C800.c.o(.rodata);
        build/us/src/engine/D000.c.o(.rodata);
        build/us/src/engine/D800.c.o(.rodata);
        build/us/src/engine/E000.c.o(.rodata);
        build/us/src/engine/E800.c.o(.rodata);
        build/us/src/engine/F000.c.o(.rodata);
        build/us/src/engine/F800.c.o(.rodata);
        build/us/src/engine/10004.c.o(.rodata);
        build/us/src/engine/10800.c.o(.rodata);
        build/us/src/engine/11000.c.o(.rodata);
        build/us/src/engine/11800.c.o(.rodata);
        build/us/src/engine/12000.c.o(.rodata);
        build/us/src/engine/12800.c.o(.rodata);
        build/us/src/engine/13000.c.o(.rodata);
        build/us/src/engine/13800.c.o(.rodata);
        build/us/src/engine/14000.c.o(.rodata);
        build/us/src/engine/14800.c.o(.rodata);
        build/us/src/engine/15000.c.o(.rodata);
        build/us/src/engine/15800.c.o(.rodata);
        build/us/src/engine/16000.c.o(.rodata);
        build/us/src/engine/16800.c.o(.rodata);
        build/us/src/engine/17000.c.o(.rodata);
        build/us/src/engine/17804.c.o(.rodata);
        build/us/src/engine/18058.c.o(.rodata);
        build/us/src/engine/18804.c.o(.rodata);
        build/us/src/engine/18E84.c.o(.rodata);
        build/us/src/engine/19000.c.o(.rodata);
        build/us/src/engine/19800.c.o(.rodata);
        build/us/src/engine/1A000.c.o(.rodata);
        build/us/src/engine/1A800.c.o(.rodata);
        build/us/src/engine/1B000.c.o(.rodata);
        build/us/src/engine/1B800.c.o(.rodata);
        build/us/src/engine/1C000.c.o(.rodata);
        build/us/src/engine/1C800.c.o(.rodata);
        build/us/src/engine/1D000.c.o(.rodata);
        build/us/src/engine/1D800.c.o(.rodata);
        build/us/src/engine/1E000.c.o(.rodata);
        build/us/src/engine/1E800.c.o(.rodata);
        build/us/src/engine/1F000.c.o(.rodata);
        build/us/src/engine/1F800.c.o(.rodata);
        build/us/src/engine/20000.c.o(.rodata);
        build/us/src/engine/20800.c.o(.rodata);
        build/us/src/engine/21000.c.o(.rodata);
        build/us/src/engine/21800.c.o(.rodata);
        build/us/src/engine/22000.c.o(.rodata);
        build/us/src/engine/22800.c.o(.rodata);
        build/us/src/engine/23000.c.o(.rodata);
        build/us/src/engine/23800.c.o(.rodata);
        build/us/src/engine/24000.c.o(.rodata);
        build/us/src/engine/24800.c.o(.rodata);
        build/us/src/engine/25000.c.o(.rodata);
        build/us/src/engine/25800.c.o(.rodata);
        build/us/src/engine/26000.c.o(.rodata);
        build/us/src/engine/26800.c.o(.rodata);
        build/us/src/engine/27000.c.o(.rodata);
        build/us/src/engine/27810.c.o(.rodata);
        build/us/src/engine/28000.c.o(.rodata);
        build/us/src/engine/28800.c.o(.rodata);
        build/us/src/engine/29000.c.o(.rodata);
        build/us/src/engine/29800.c.o(.rodata);
        build/us/src/engine/2A074.c.o(.rodata);
        build/us/src/engine/2A814.c.o(.rodata);
        build/us/src/engine/2B800.c.o(.rodata);
        build/us/src/engine/2C000.c.o(.rodata);
        build/us/src/engine/2C800.c.o(.rodata);
        build/us/src/engine/2D000.c.o(.rodata);
        build/us/src/engine/2D800.c.o(.rodata);
        build/us/src/engine/2E000.c.o(.rodata);
        build/us/src/engine/2E79C.c.o(.rodata);
        build/us/src/engine/2F000.c.o(.rodata);
        build/us/src/engine/2F800.c.o(.rodata);
        build/us/src/engine/30000.c.o(.rodata);
        build/us/src/engine/307BC.c.o(.rodata);
        build/us/src/engine/30800.c.o(.rodata);
        build/us/src/engine/312CC.c.o(.rodata);
        build/us/src/engine/31800.c.o(.rodata);
        build/us/src/engine/32000.c.o(.rodata);
        build/us/src/engine/32680.c.o(.rodata);
        build/us/src/engine/32800.c.o(.rodata);
        build/us/src/engine/32948.c.o(.rodata);
        build/us/src/engine/32FEC.c.o(.rodata);
        build/us/src/engine/3354C.c.o(.rodata);
        build/us/src/engine/3356C.c.o(.rodata);
        build/us/src/engine/336B8.c.o(.rodata);
        build/us/src/engine/33F00.c.o(.rodata);
        build/us/src/engine/34000.c.o(.rodata);
        build/us/src/engine/347CC.c.o(.rodata);
        build/us/src/engine/34BF8.c.o(.rodata);
        build/us/src/engine/34C10.c.o(.rodata);
        build/us/src/engine/35000.c.o(.rodata);
        build/us/src/engine/35800.c.o(.rodata);
        build/us/src/engine/35FDC.c.o(.rodata);
        build/us/src/engine/35FFC.c.o(.rodata);
        build/us/src/engine/360FC.c.o(.rodata);
        build/us/src/engine/36B44.c.o(.rodata);
        build/us/src/engine/37000.c.o(.rodata);
        build/us/src/engine/37800.c.o(.rodata);
        build/us/src/engine/387A0.c.o(.rodata);
        build/us/src/engine/38EFC.c.o(.rodata);
        build/us/src/engine/39800.c.o(.rodata);
        build/us/src/engine/39FFC.c.o(.rodata);
        build/us/src/engine/3A000.c.o(.rodata);
        build/us/src/engine/3B7FC.c.o(.rodata);
        build/us/src/engine/3BDFC.c.o(.rodata);
        build/us/src/engine/3C000.c.o(.rodata);
        build/us/src/engine/3C800.c.o(.rodata);
        build/us/src/engine/3D000.c.o(.rodata);
        build/us/src/engine/3D800.c.o(.rodata);
        build/us/src/engine/3DEAC.c.o(.rodata);
        build/us/src/engine/3ECEC.c.o(.rodata);
        build/us/src/engine/3F000.c.o(.rodata);
        build/us/src/engine/3F7CC.c.o(.rodata);
        build/us/src/engine/3FFFC.c.o(.rodata);
        build/us/src/engine/40000.c.o(.rodata);
        build/us/src/engine/40800.c.o(.rodata);
        build/us/src/engine/40C6C.c.o(.rodata);
        build/us/src/engine/41000.c.o(.rodata);
        build/us/src/engine/415EC.c.o(.rodata);
        build/us/src/engine/42000.c.o(.rodata);
        build/us/src/engine/42800.c.o(.rodata);
        build/us/src/engine/42C0C.c.o(.rodata);
        build/us/src/engine/4378C.c.o(.rodata);
        build/us/src/engine/43FDC.c.o(.rodata);
        build/us/src/engine/44164.c.o(.rodata);
        build/us/src/engine/44308.c.o(.rodata);
        build/us/src/engine/4495C.c.o(.rodata);
        build/us/src/engine/4510C.c.o(.rodata);
        build/us/src/engine/4590C.c.o(.rodata);
        build/us/src/engine/45F60.c.o(.rodata);
        build/us/src/engine/45FC0.c.o(.rodata);
        build/us/src/engine/46EA4.c.o(.rodata);
        build/us/src/engine/47000.c.o(.rodata);
        build/us/src/engine/47800.c.o(.rodata);
        build/us/src/engine/48000.c.o(.rodata);
        build/us/src/engine/48860.c.o(.rodata);
        build/us/src/engine/48FD8.c.o(.rodata);
        build/us/src/engine/4971C.c.o(.rodata);
        build/us/src/engine/49FD4.c.o(.rodata);
        build/us/src/engine/4A67C.c.o(.rodata);
        build/us/src/engine/4AFDC.c.o(.rodata);
        build/us/src/engine/4B6EC.c.o(.rodata);
        build/us/src/engine/4B800.c.o(.rodata);
        build/us/src/engine/4BF5C.c.o(.rodata);
        build/us/src/engine/4C800.c.o(.rodata);
        build/us/src/engine/4CFF4.c.o(.rodata);
        build/us/src/engine/4D7CC.c.o(.rodata);
        build/us/src/engine/4D800.c.o(.rodata);
        build/us/src/engine/4DE3C.c.o(.rodata);
        build/us/src/engine/4E478.c.o(.rodata);
        build/us/src/engine/4EFA8.c.o(.rodata);
        . = ALIGN(., 4);
        main_RODATA_END = .;
        main_RODATA_SIZE = ABSOLUTE(main_RODATA_END - main_RODATA_START);
        main_TEXT_START = .;
        build/us/src/engine/B618.c.o(.text);
        build/us/src/engine/B800.c.o(.text);
        build/us/src/engine/C000.c.o(.text);
        build/us/src/engine/C800.c.o(.text);
        build/us/src/engine/D000.c.o(.text);
        build/us/src/engine/D800.c.o(.text);
        build/us/src/engine/E000.c.o(.text);
        build/us/src/engine/E800.c.o(.text);
        build/us/src/engine/F000.c.o(.text);
        func_8001F000 = (func_8001EFB0 + 0x50);
        build/us/src/engine/F800.c.o(.text);
        build/us/src/engine/10004.c.o(.text);
        build/us/src/engine/10800.c.o(.text);
        build/us/src/engine/11000.c.o(.text);
        build/us/src/engine/11800.c.o(.text);
        build/us/src/engine/12000.c.o(.text);
        build/us/src/engine/12800.c.o(.text);
        build/us/src/engine/13000.c.o(.text);
        build/us/src/engine/13800.c.o(.text);
        build/us/src/engine/14000.c.o(.text);
        build/us/src/engine/14800.c.o(.text);
        build/us/src/engine/15000.c.o(.text);
        build/us/src/engine/15800.c.o(.text);
        build/us/src/engine/16000.c.o(.text);
        build/us/src/engine/16800.c.o(.text);
        build/us/src/engine/17000.c.o(.text);
        build/us/src/engine/17804.c.o(.text);
        build/us/src/engine/18058.c.o(.text);
        build/us/src/engine/18804.c.o(.text);
        build/us/src/engine/18E84.c.o(.text);
        build/us/src/engine/19000.c.o(.text);
        build/us/src/engine/19800.c.o(.text);
        build/us/src/engine/1A000.c.o(.text);
        build/us/src/engine/1A800.c.o(.text);
        build/us/src/engine/1B000.c.o(.text);
        build/us/src/engine/1B800.c.o(.text);
        build/us/src/engine/1C000.c.o(.text);
        build/us/src/engine/1C800.c.o(.text);
        build/us/src/engine/1D000.c.o(.text);
        build/us/src/engine/1D800.c.o(.text);
        build/us/src/engine/1E000.c.o(.text);
        build/us/src/engine/1E800.c.o(.text);
        build/us/src/engine/1F000.c.o(.text);
        build/us/src/engine/1F800.c.o(.text);
        build/us/src/engine/20000.c.o(.text);
        build/us/src/engine/20800.c.o(.text);
        build/us/src/engine/21000.c.o(.text);
        build/us/src/engine/21800.c.o(.text);
        build/us/src/engine/22000.c.o(.text);
        build/us/src/engine/22800.c.o(.text);
        build/us/src/engine/23000.c.o(.text);
        build/us/src/engine/23800.c.o(.text);
        build/us/src/engine/24000.c.o(.text);
        build/us/src/engine/24800.c.o(.text);
        build/us/src/engine/25000.c.o(.text);
        func_80034B88 = (func_80034B38 + 0x50);
        func_80034BC8 = (func_80034B38 + 0x90);
        /* Reviewed call/epilogue continuation in the emitted100B frame. */
        func_800349F4 = (func_800349A8 + 0x4C);
        build/us/src/engine/25800.c.o(.text);
        build/us/src/engine/26000.c.o(.text);
        build/us/src/engine/26800.c.o(.text);
        build/us/src/engine/27000.c.o(.text);
        build/us/src/engine/27810.c.o(.text);
        build/us/src/engine/28000.c.o(.text);
        build/us/src/engine/28800.c.o(.text);
        build/us/src/engine/29000.c.o(.text);
        build/us/src/engine/29800.c.o(.text);
        build/us/src/engine/2A074.c.o(.text);
        build/us/src/engine/2A814.c.o(.text);
        build/us/src/engine/2B034.c.o(.text);
        .L8003AB00 = (. - 1988 + 0x2cc);
        .L8003ABA4 = (. - 1988 + 0x370);
        .L8003AC48 = (. - 1988 + 0x414);
        .L8003AC94 = (. - 1988 + 0x460);
        .L8003ACE8 = (. - 1988 + 0x4b4);
        .L8003AD3C = (. - 1988 + 0x508);
        .L8003AD98 = (. - 1988 + 0x564);
        .L8003ADBC = (. - 1988 + 0x588);
        .L8003AE48 = (. - 1988 + 0x614);
        .L8003AE94 = (. - 1988 + 0x660);
        .L8003AEE8 = (. - 1988 + 0x6b4);
        .L8003AF3C = (. - 1988 + 0x708);
        .L8003AFCC = (. - 1988 + 0x798);
        .L8003AFD4 = (. - 1988 + 0x7a0);
        build/us/src/engine/2B800.c.o(.text);
        func_8003B000 = (func_8003AFF8 + 0x8);
        build/us/src/engine/2C000.c.o(.text);
        build/us/src/engine/2C800.c.o(.text);
        build/us/src/engine/2D000.c.o(.text);
        build/us/src/engine/2D800.c.o(.text);
        func_8003D800 = (func_8003D7F0 + 0x10);
        build/us/src/engine/2E000.c.o(.text);
        . += 0x4;
        build/us/src/engine/2E000.c.o(.text.tail_func_8003DF5C);
        . += 0xC;
        build/us/src/engine/2E79C.c.o(.text);
        build/us/src/engine/2E79C.c.o(.text);
        build/us/src/engine/2F000.c.o(.text);
        build/us/src/engine/2F800.c.o(.text);
        build/us/src/engine/30000.c.o(.text);
        build/us/src/engine/307BC.c.o(.text);
        build/us/src/engine/30800.c.o(.text);
        build/us/src/engine/30800.c.o(.text);
        build/us/src/engine/312CC.c.o(.text);
        build/us/src/engine/31800.c.o(.text);
        build/us/src/engine/32000.c.o(.text);
        build/us/src/engine/32680.c.o(.text);
        build/us/src/engine/32800.c.o(.text);
        build/us/src/engine/32948.c.o(.text);
        build/us/src/engine/32FEC.c.o(.text);
        build/us/src/engine/32FEC.c.o(.text);
        build/us/src/engine/3354C.c.o(.text);
        . += 0xC;
        build/us/src/engine/3356C.c.o(.text);
        build/us/src/engine/336B8.c.o(.text);
        build/us/src/engine/336B8.c.o(.text);
        build/us/src/engine/33F00.c.o(.text);
        build/us/src/engine/34000.c.o(.text);
        build/us/src/engine/347CC.c.o(.text);
        build/us/src/engine/347CC.c.o(.text);
        build/us/src/engine/34BF8.c.o(.text);
        build/us/src/engine/34C10.c.o(.text);
        build/us/src/engine/35000.c.o(.text);
        build/us/src/engine/35800.c.o(.text);
        build/us/src/engine/35FDC.c.o(.text);
        . += 0x4;
        build/us/src/engine/35FFC.c.o(.text);
        build/us/src/engine/35FFC.c.o(.text);
        build/us/src/engine/360FC.c.o(.text);
        build/us/src/engine/360FC.c.o(.text);
        build/us/src/engine/36B44.c.o(.text);
        build/us/src/engine/37000.c.o(.text);
        . += 0xC;
        build/us/src/engine/37000.c.o(.text.tail_func_8004685C);
        . += 0xC;
        build/us/src/engine/37000.c.o(.text.tail_func_80046DBC);
        . += 0xC;
        build/us/src/engine/37000.c.o(.text.tail_func_80046DDC);
        build/us/src/engine/37800.c.o(.text);
        build/us/src/engine/37800.c.o(.text);
        build/us/src/engine/387A0.c.o(.text);
        build/us/src/engine/387A0.c.o(.text);
        build/us/src/engine/38EFC.c.o(.text);
        build/us/src/engine/38EFC.c.o(.text);
        build/us/src/engine/39800.c.o(.text);
        build/us/src/engine/39FFC.c.o(.text);
        build/us/src/engine/3A000.c.o(.text);
        build/us/src/engine/3A000.c.o(.text);
        build/us/src/engine/3A000.c.o(.text);
        build/us/src/engine/3B7FC.c.o(.text);
        build/us/src/engine/3B7FC.c.o(.text);
        build/us/src/engine/3BDFC.c.o(.text);
        build/us/src/engine/3C000.c.o(.text);
        build/us/src/engine/3C800.c.o(.text);
        build/us/src/engine/3D000.c.o(.text);
        build/us/src/engine/3D800.c.o(.text);
        build/us/src/engine/3DEAC.c.o(.text);
        build/us/src/engine/3DEAC.c.o(.text);
        build/us/src/engine/3DEAC.c.o(.text);
        build/us/src/engine/3ECEC.c.o(.text);
        build/us/src/engine/3F000.c.o(.text);
        build/us/src/engine/3F7CC.c.o(.text);
        build/us/src/engine/3F7CC.c.o(.text);
        build/us/src/engine/3FFFC.c.o(.text);
        build/us/src/engine/40000.c.o(.text);
        build/us/src/engine/40800.c.o(.text);
        . += 0xC;
        build/us/src/engine/40800.c.o(.text.tail_func_8005004C);
        build/us/src/engine/40C6C.c.o(.text);
        build/us/src/engine/41000.c.o(.text);
        build/us/src/engine/415EC.c.o(.text);
        build/us/src/engine/415EC.c.o(.text);
        build/us/src/engine/42000.c.o(.text);
        build/us/src/engine/42800.c.o(.text);
        build/us/src/engine/42C0C.c.o(.text);
        build/us/src/engine/42C0C.c.o(.text);
        build/us/src/engine/4378C.c.o(.text);
        build/us/src/engine/4378C.c.o(.text);
        . += 0x4;
        build/us/src/engine/43FDC.c.o(.text);
        build/us/src/engine/43FDC.c.o(.text);
        build/us/src/engine/44164.c.o(.text);
        build/us/src/engine/44308.c.o(.text);
        . += 0x8;
        build/us/src/engine/44308.c.o(.text.tail_func_80053E7C);
        build/us/src/engine/44308.c.o(.text);
        build/us/src/engine/4495C.c.o(.text);
        build/us/src/engine/4495C.c.o(.text);
        build/us/src/engine/4510C.c.o(.text);
        build/us/src/engine/4510C.c.o(.text);
        build/us/src/engine/4590C.c.o(.text);
        build/us/src/engine/45F60.c.o(.text);
        build/us/src/engine/45FC0.c.o(.text);
        build/us/src/engine/45FC0.c.o(.text);
        build/us/src/engine/45FC0.c.o(.text);
        build/us/src/engine/46EA4.c.o(.text);
        build/us/src/engine/47000.c.o(.text);
        build/us/src/engine/47800.c.o(.text);
        build/us/src/engine/48000.c.o(.text);
        build/us/src/engine/48000.c.o(.text);
        build/us/src/engine/48860.c.o(.text);
        . += 0x4;
        build/us/src/engine/48860.c.o(.text.tail_func_8005842C);
        . += 0x8;
        build/us/src/engine/48860.c.o(.text.tail_func_8005844C);
        . += 0x4;
        build/us/src/engine/48860.c.o(.text.tail_func_8005858C);
        build/us/src/engine/48FD8.c.o(.text);
        build/us/src/engine/48FD8.c.o(.text);
        build/us/src/engine/4971C.c.o(.text);
        build/us/src/engine/4971C.c.o(.text);
        build/us/src/engine/49FD4.c.o(.text);
        build/us/src/engine/49FD4.c.o(.text);
        build/us/src/engine/4A67C.c.o(.text);
        build/us/src/engine/4A67C.c.o(.text);
        . += 0x8;
        build/us/src/engine/4A67C.c.o(.text.tail_func_8005A45C);
        build/us/src/engine/4AFDC.c.o(.text);
        build/us/src/engine/4AFDC.c.o(.text);
        build/us/src/engine/4B6EC.c.o(.text);
        build/us/src/engine/4B800.c.o(.text);
        build/us/src/engine/4BF5C.c.o(.text);
        build/us/src/engine/4BF5C.c.o(.text);
        build/us/src/engine/4C800.c.o(.text);
        build/us/src/engine/4CFF4.c.o(.text);
        build/us/src/engine/4CFF4.c.o(.text);
        build/us/src/engine/4D7CC.c.o(.text);
        build/us/src/engine/4D800.c.o(.text);
        build/us/src/engine/4DE3C.c.o(.text);
        build/us/src/engine/4DE3C.c.o(.text);
        build/us/src/engine/4E478.c.o(.text);
        build/us/src/engine/4E478.c.o(.text);
        build/us/src/engine/4EFA8.c.o(.text);
        build/us/src/engine/4EFA8.c.o(.text);
        . = ALIGN(., 4);
        func_800225D4 = func_80022560 + 0x74;
        func_80022800 = func_80022778 + 0x88;
        func_80023000 = func_80022F90 + 0x70;
        main_TEXT_END = .;
        main_TEXT_SIZE = ABSOLUTE(main_TEXT_END - main_TEXT_START);
        main_DATA_START = .;
        build/us/asm/us/main/data/800.rodata.s.o(.data);
        build/us/src/engine/B618.c.o(.data);
        build/us/src/engine/B800.c.o(.data);
        build/us/src/engine/C000.c.o(.data);
        build/us/src/engine/C800.c.o(.data);
        build/us/src/engine/D000.c.o(.data);
        build/us/src/engine/D800.c.o(.data);
        build/us/src/engine/E000.c.o(.data);
        build/us/src/engine/E800.c.o(.data);
        build/us/src/engine/F000.c.o(.data);
        build/us/src/engine/F800.c.o(.data);
        build/us/src/engine/10004.c.o(.data);
        build/us/src/engine/10800.c.o(.data);
        build/us/src/engine/11000.c.o(.data);
        build/us/src/engine/11800.c.o(.data);
        build/us/src/engine/12000.c.o(.data);
        build/us/src/engine/12800.c.o(.data);
        build/us/src/engine/13000.c.o(.data);
        build/us/src/engine/13800.c.o(.data);
        build/us/src/engine/14000.c.o(.data);
        build/us/src/engine/14800.c.o(.data);
        build/us/src/engine/15000.c.o(.data);
        build/us/src/engine/15800.c.o(.data);
        build/us/src/engine/16000.c.o(.data);
        build/us/src/engine/16800.c.o(.data);
        build/us/src/engine/17000.c.o(.data);
        build/us/src/engine/17804.c.o(.data);
        build/us/src/engine/18058.c.o(.data);
        build/us/src/engine/18804.c.o(.data);
        build/us/src/engine/18E84.c.o(.data);
        build/us/src/engine/19000.c.o(.data);
        build/us/src/engine/19800.c.o(.data);
        build/us/src/engine/1A000.c.o(.data);
        build/us/src/engine/1A800.c.o(.data);
        build/us/src/engine/1B000.c.o(.data);
        build/us/src/engine/1B800.c.o(.data);
        build/us/src/engine/1C000.c.o(.data);
        build/us/src/engine/1C800.c.o(.data);
        build/us/src/engine/1D000.c.o(.data);
        build/us/src/engine/1D800.c.o(.data);
        build/us/src/engine/1E000.c.o(.data);
        build/us/src/engine/1E800.c.o(.data);
        build/us/src/engine/1F000.c.o(.data);
        build/us/src/engine/1F800.c.o(.data);
        build/us/src/engine/20000.c.o(.data);
        build/us/src/engine/20800.c.o(.data);
        build/us/src/engine/21000.c.o(.data);
        build/us/src/engine/21800.c.o(.data);
        build/us/src/engine/22000.c.o(.data);
        build/us/src/engine/22800.c.o(.data);
        build/us/src/engine/23000.c.o(.data);
        build/us/src/engine/23800.c.o(.data);
        build/us/src/engine/24000.c.o(.data);
        build/us/src/engine/24800.c.o(.data);
        build/us/src/engine/25000.c.o(.data);
        build/us/src/engine/25800.c.o(.data);
        build/us/src/engine/26000.c.o(.data);
        build/us/src/engine/26800.c.o(.data);
        build/us/src/engine/27000.c.o(.data);
        build/us/src/engine/27810.c.o(.data);
        build/us/src/engine/28000.c.o(.data);
        build/us/src/engine/28800.c.o(.data);
        build/us/src/engine/29000.c.o(.data);
        build/us/src/engine/29800.c.o(.data);
        build/us/src/engine/2A074.c.o(.data);
        build/us/src/engine/2A814.c.o(.data);
        build/us/src/engine/2B034.c.o(.data);
        build/us/src/engine/2B800.c.o(.data);
        build/us/src/engine/2C000.c.o(.data);
        build/us/src/engine/2C800.c.o(.data);
        build/us/src/engine/2D000.c.o(.data);
        build/us/src/engine/2D800.c.o(.data);
        build/us/src/engine/2E000.c.o(.data);
        build/us/src/engine/2E79C.c.o(.data);
        build/us/src/engine/2F000.c.o(.data);
        build/us/src/engine/2F800.c.o(.data);
        build/us/src/engine/30000.c.o(.data);
        build/us/src/engine/307BC.c.o(.data);
        build/us/src/engine/30800.c.o(.data);
        build/us/src/engine/312CC.c.o(.data);
        build/us/src/engine/31800.c.o(.data);
        build/us/src/engine/32000.c.o(.data);
        build/us/src/engine/32680.c.o(.data);
        build/us/src/engine/32800.c.o(.data);
        build/us/src/engine/32948.c.o(.data);
        build/us/src/engine/32FEC.c.o(.data);
        build/us/src/engine/3354C.c.o(.data);
        build/us/src/engine/3356C.c.o(.data);
        build/us/src/engine/336B8.c.o(.data);
        build/us/src/engine/33F00.c.o(.data);
        build/us/src/engine/34000.c.o(.data);
        build/us/src/engine/347CC.c.o(.data);
        build/us/src/engine/34BF8.c.o(.data);
        build/us/src/engine/34C10.c.o(.data);
        build/us/src/engine/35000.c.o(.data);
        build/us/src/engine/35800.c.o(.data);
        build/us/src/engine/35FDC.c.o(.data);
        build/us/src/engine/35FFC.c.o(.data);
        build/us/src/engine/360FC.c.o(.data);
        build/us/src/engine/36B44.c.o(.data);
        build/us/src/engine/37000.c.o(.data);
        build/us/src/engine/37800.c.o(.data);
        build/us/src/engine/387A0.c.o(.data);
        build/us/src/engine/38EFC.c.o(.data);
        build/us/src/engine/39800.c.o(.data);
        build/us/src/engine/39FFC.c.o(.data);
        build/us/src/engine/3A000.c.o(.data);
        build/us/src/engine/3B7FC.c.o(.data);
        build/us/src/engine/3BDFC.c.o(.data);
        build/us/src/engine/3C000.c.o(.data);
        build/us/src/engine/3C800.c.o(.data);
        build/us/src/engine/3D000.c.o(.data);
        build/us/src/engine/3D800.c.o(.data);
        build/us/src/engine/3DEAC.c.o(.data);
        build/us/src/engine/3ECEC.c.o(.data);
        build/us/src/engine/3F000.c.o(.data);
        build/us/src/engine/3F7CC.c.o(.data);
        build/us/src/engine/3FFFC.c.o(.data);
        build/us/src/engine/40000.c.o(.data);
        build/us/src/engine/40800.c.o(.data);
        build/us/src/engine/40C6C.c.o(.data);
        build/us/src/engine/41000.c.o(.data);
        build/us/src/engine/415EC.c.o(.data);
        build/us/src/engine/42000.c.o(.data);
        build/us/src/engine/42800.c.o(.data);
        build/us/src/engine/42C0C.c.o(.data);
        build/us/src/engine/4378C.c.o(.data);
        build/us/src/engine/43FDC.c.o(.data);
        build/us/src/engine/44164.c.o(.data);
        build/us/src/engine/44308.c.o(.data);
        build/us/src/engine/4495C.c.o(.data);
        build/us/src/engine/4510C.c.o(.data);
        build/us/src/engine/4590C.c.o(.data);
        build/us/src/engine/45F60.c.o(.data);
        build/us/src/engine/45FC0.c.o(.data);
        build/us/src/engine/46EA4.c.o(.data);
        build/us/src/engine/47000.c.o(.data);
        build/us/src/engine/47800.c.o(.data);
        build/us/src/engine/48000.c.o(.data);
        build/us/src/engine/48860.c.o(.data);
        build/us/src/engine/48FD8.c.o(.data);
        build/us/src/engine/4971C.c.o(.data);
        build/us/src/engine/49FD4.c.o(.data);
        build/us/src/engine/4A67C.c.o(.data);
        build/us/src/engine/4AFDC.c.o(.data);
        build/us/src/engine/4B6EC.c.o(.data);
        build/us/src/engine/4B800.c.o(.data);
        build/us/src/engine/4BF5C.c.o(.data);
        build/us/src/engine/4C800.c.o(.data);
        build/us/src/engine/4CFF4.c.o(.data);
        build/us/src/engine/4D7CC.c.o(.data);
        build/us/src/engine/4D800.c.o(.data);
        build/us/src/engine/4DE3C.c.o(.data);
        build/us/src/engine/4E478.c.o(.data);
        build/us/src/engine/4EFA8.c.o(.data);
        /* Reviewed retail prefix including owned font pointer, RNG table and suffix. */
        build/us/asm/us/main/data/4F61C.data.s.o(.data.rng_prefix);
        ASSERT(ABSOLUTE(.) == 0x800641A0, "Current-thread prefix placement mismatch");
        build/us/src/engine/F800.c.o(.sdata);
        ASSERT(ABSOLUTE(D_800641A0) == 0x800641A0, "Current-thread identifier address mismatch");
        ASSERT(ABSOLUTE(.) == 0x800641A4, "Current-thread identifier extent mismatch");
        build/us/asm/us/main/data/4F61C.data.s.o(.data.thread_suffix);
        ASSERT(ABSOLUTE(.) == 0x8006436C, "Font prefix placement mismatch");
        build/us/src/engine/22000.c.o(.sdata);
        ASSERT(ABSOLUTE(D_8006436C) == 0x8006436C, "Font cache pointer address mismatch");
        ASSERT(ABSOLUTE(.) == 0x80064370, "Font cache pointer extent mismatch");
        build/us/asm/us/main/data/4F61C.data.s.o(.data.font_suffix);
        ASSERT(ABSOLUTE(.) == 0x8006439C, "RNG prefix placement mismatch");
        build/us/src/engine/27810.c.o(.sdata);
        ASSERT(ABSOLUTE(D_8006439C) == 0x8006439C, "RNG public table address mismatch");
        ASSERT(ABSOLUTE(.) == 0x800643A4, "RNG owned table extent mismatch");
        build/us/asm/us/main/data/4F61C.data.s.o(.data.rng_suffix);
        ASSERT(ABSOLUTE(.) == 0x800643A4, "Zlib owned marker start mismatch");
        build/us/src/engine/2B800.c.o(.sdata);
        ASSERT(ABSOLUTE(D_800643A4) == 0x800643A4, "Zlib marker public address mismatch");
        ASSERT(ABSOLUTE(.) == 0x800643A8, "Zlib marker extent mismatch");
        build/us/src/engine/2E000.c.o(.sdata);
        ASSERT(ABSOLUTE(D_800643A8) == 0x800643A8, "Zlib literal bits address mismatch");
        ASSERT(ABSOLUTE(D_800643AC) == 0x800643AC, "Zlib distance bits address mismatch");
        ASSERT(ABSOLUTE(.) == 0x800643B0, "Zlib fixed bits extent mismatch");
        build/us/asm/us/main/data/4F61C.data.s.o(.data.zlib_suffix);
        ASSERT(ABSOLUTE(.) == 0x800643BC, "RNG suffix placement mismatch");
        . = ALIGN(., 4);
        main_DATA_END = .;
        main_DATA_SIZE = ABSOLUTE(main_DATA_END - main_DATA_START);
        main_BSS_START = .;
        build/us/asm/us/main/data/800.rodata.s.o(.bss);
        build/us/src/engine/B618.c.o(.bss);
        build/us/src/engine/B800.c.o(.bss);
        build/us/src/engine/C000.c.o(.bss);
        build/us/src/engine/C800.c.o(.bss);
        build/us/src/engine/D000.c.o(.bss);
        build/us/src/engine/D800.c.o(.bss);
        build/us/src/engine/E000.c.o(.bss);
        build/us/src/engine/E800.c.o(.bss);
        build/us/src/engine/F000.c.o(.bss);
        build/us/src/engine/F800.c.o(.bss);
        build/us/src/engine/10004.c.o(.bss);
        build/us/src/engine/10800.c.o(.bss);
        build/us/src/engine/11000.c.o(.bss);
        build/us/src/engine/11800.c.o(.bss);
        build/us/src/engine/12000.c.o(.bss);
        build/us/src/engine/12800.c.o(.bss);
        build/us/src/engine/13000.c.o(.bss);
        build/us/src/engine/13800.c.o(.bss);
        build/us/src/engine/14000.c.o(.bss);
        build/us/src/engine/14800.c.o(.bss);
        build/us/src/engine/15000.c.o(.bss);
        build/us/src/engine/15800.c.o(.bss);
        build/us/src/engine/16000.c.o(.bss);
        build/us/src/engine/16800.c.o(.bss);
        build/us/src/engine/17000.c.o(.bss);
        build/us/src/engine/17804.c.o(.bss);
        build/us/src/engine/18058.c.o(.bss);
        build/us/src/engine/18804.c.o(.bss);
        build/us/src/engine/18E84.c.o(.bss);
        build/us/src/engine/19000.c.o(.bss);
        build/us/src/engine/19800.c.o(.bss);
        build/us/src/engine/1A000.c.o(.bss);
        build/us/src/engine/1A800.c.o(.bss);
        build/us/src/engine/1B000.c.o(.bss);
        build/us/src/engine/1B800.c.o(.bss);
        build/us/src/engine/1C000.c.o(.bss);
        build/us/src/engine/1C800.c.o(.bss);
        build/us/src/engine/1D000.c.o(.bss);
        build/us/src/engine/1D800.c.o(.bss);
        build/us/src/engine/1E000.c.o(.bss);
        build/us/src/engine/1E800.c.o(.bss);
        build/us/src/engine/1F000.c.o(.bss);
        build/us/src/engine/1F800.c.o(.bss);
        build/us/src/engine/20000.c.o(.bss);
        build/us/src/engine/20800.c.o(.bss);
        build/us/src/engine/21000.c.o(.bss);
        build/us/src/engine/21800.c.o(.bss);
        build/us/src/engine/22000.c.o(.bss);
        build/us/src/engine/22800.c.o(.bss);
        build/us/src/engine/23000.c.o(.bss);
        build/us/src/engine/23800.c.o(.bss);
        build/us/src/engine/24000.c.o(.bss);
        build/us/src/engine/24800.c.o(.bss);
        build/us/src/engine/25000.c.o(.bss);
        build/us/src/engine/25800.c.o(.bss);
        build/us/src/engine/26000.c.o(.bss);
        build/us/src/engine/26800.c.o(.bss);
        build/us/src/engine/27000.c.o(.bss);
        build/us/src/engine/27810.c.o(.bss);
        build/us/src/engine/28000.c.o(.bss);
        build/us/src/engine/28800.c.o(.bss);
        build/us/src/engine/29000.c.o(.bss);
        build/us/src/engine/29800.c.o(.bss);
        build/us/src/engine/2A074.c.o(.bss);
        build/us/src/engine/2A814.c.o(.bss);
        build/us/src/engine/2B034.c.o(.bss);
        build/us/src/engine/2B800.c.o(.bss);
        build/us/src/engine/2C000.c.o(.bss);
        build/us/src/engine/2C800.c.o(.bss);
        build/us/src/engine/2D000.c.o(.bss);
        build/us/src/engine/2D800.c.o(.bss);
        build/us/src/engine/2E000.c.o(.bss);
        build/us/src/engine/2E79C.c.o(.bss);
        build/us/src/engine/2F000.c.o(.bss);
        build/us/src/engine/2F800.c.o(.bss);
        build/us/src/engine/30000.c.o(.bss);
        build/us/src/engine/307BC.c.o(.bss);
        build/us/src/engine/30800.c.o(.bss);
        build/us/src/engine/312CC.c.o(.bss);
        build/us/src/engine/31800.c.o(.bss);
        build/us/src/engine/32000.c.o(.bss);
        build/us/src/engine/32680.c.o(.bss);
        build/us/src/engine/32800.c.o(.bss);
        build/us/src/engine/32948.c.o(.bss);
        build/us/src/engine/32FEC.c.o(.bss);
        build/us/src/engine/3354C.c.o(.bss);
        build/us/src/engine/3356C.c.o(.bss);
        build/us/src/engine/336B8.c.o(.bss);
        build/us/src/engine/33F00.c.o(.bss);
        build/us/src/engine/34000.c.o(.bss);
        build/us/src/engine/347CC.c.o(.bss);
        build/us/src/engine/34BF8.c.o(.bss);
        build/us/src/engine/34C10.c.o(.bss);
        build/us/src/engine/35000.c.o(.bss);
        build/us/src/engine/35800.c.o(.bss);
        build/us/src/engine/35FDC.c.o(.bss);
        build/us/src/engine/35FFC.c.o(.bss);
        build/us/src/engine/360FC.c.o(.bss);
        build/us/src/engine/36B44.c.o(.bss);
        build/us/src/engine/37000.c.o(.bss);
        build/us/src/engine/37800.c.o(.bss);
        build/us/src/engine/387A0.c.o(.bss);
        build/us/src/engine/38EFC.c.o(.bss);
        build/us/src/engine/39800.c.o(.bss);
        build/us/src/engine/39FFC.c.o(.bss);
        build/us/src/engine/3A000.c.o(.bss);
        build/us/src/engine/3B7FC.c.o(.bss);
        build/us/src/engine/3BDFC.c.o(.bss);
        build/us/src/engine/3C000.c.o(.bss);
        build/us/src/engine/3C800.c.o(.bss);
        build/us/src/engine/3D000.c.o(.bss);
        build/us/src/engine/3D800.c.o(.bss);
        build/us/src/engine/3DEAC.c.o(.bss);
        build/us/src/engine/3ECEC.c.o(.bss);
        build/us/src/engine/3F000.c.o(.bss);
        build/us/src/engine/3F7CC.c.o(.bss);
        build/us/src/engine/3FFFC.c.o(.bss);
        build/us/src/engine/40000.c.o(.bss);
        build/us/src/engine/40800.c.o(.bss);
        build/us/src/engine/40C6C.c.o(.bss);
        build/us/src/engine/41000.c.o(.bss);
        build/us/src/engine/415EC.c.o(.bss);
        build/us/src/engine/42000.c.o(.bss);
        build/us/src/engine/42800.c.o(.bss);
        build/us/src/engine/42C0C.c.o(.bss);
        build/us/src/engine/4378C.c.o(.bss);
        build/us/src/engine/43FDC.c.o(.bss);
        build/us/src/engine/44164.c.o(.bss);
        build/us/src/engine/44308.c.o(.bss);
        build/us/src/engine/4495C.c.o(.bss);
        build/us/src/engine/4510C.c.o(.bss);
        build/us/src/engine/4590C.c.o(.bss);
        build/us/src/engine/45F60.c.o(.bss);
        build/us/src/engine/45FC0.c.o(.bss);
        build/us/src/engine/46EA4.c.o(.bss);
        build/us/src/engine/47000.c.o(.bss);
        build/us/src/engine/47800.c.o(.bss);
        build/us/src/engine/48000.c.o(.bss);
        build/us/src/engine/48860.c.o(.bss);
        build/us/src/engine/48FD8.c.o(.bss);
        build/us/src/engine/4971C.c.o(.bss);
        build/us/src/engine/49FD4.c.o(.bss);
        build/us/src/engine/4A67C.c.o(.bss);
        build/us/src/engine/4AFDC.c.o(.bss);
        build/us/src/engine/4B6EC.c.o(.bss);
        build/us/src/engine/4B800.c.o(.bss);
        build/us/src/engine/4BF5C.c.o(.bss);
        build/us/src/engine/4C800.c.o(.bss);
        build/us/src/engine/4CFF4.c.o(.bss);
        build/us/src/engine/4D7CC.c.o(.bss);
        build/us/src/engine/4D800.c.o(.bss);
        build/us/src/engine/4DE3C.c.o(.bss);
        build/us/src/engine/4E478.c.o(.bss);
        build/us/src/engine/4EFA8.c.o(.bss);
        build/us/assets/Ram_Reserved.bin.o(.data);
        . = ALIGN(., 4);
        main_BSS_END = .;
        main_BSS_SIZE = ABSOLUTE(main_BSS_END - main_BSS_START);
    }
    __romPos += SIZEOF(.main);
    __romPos = ALIGN(__romPos, 4);
    . = ALIGN(., 4);
    main_ROM_END = __romPos;
    main_VRAM_END = .;

    /DISCARD/ :
    {
        *(*);
    }
}
